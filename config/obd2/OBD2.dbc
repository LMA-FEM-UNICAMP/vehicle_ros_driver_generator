VERSION ""

NS_ :

BS_:
BU_: Service__01
BO_ 1 Monitor_status_since_DTCs_cleared: 4 Service__01
   SG_ MIL_ON_OFF : 4|1@1+ (1,0) [0|1] "" Service__01
   SG_ DTC_COUNT : 0|7@1+ (1,0) [0|1] "" Service__01
   SG_ RESERVED : 15|1@1+ (1,0) [0|0] "" Service__01
   SG_ NO_NAME : 11|1@1+ (1,0) [0|1] "" Service__01

BO_ 2 Freeze_DTC: 2 Service__01

BO_ 3 Fuel_System_Status: 2 Service__01
   SG_ Fuel_System_1 : 0|8@1+ (1,0) [0|16] "" Service__01
   SG_ Fuel_System_2 : 8|8@1+ (1,0) [0|16] "" Service__01

BO_ 4 Calculated_engine_load: 1 Service__01
   SG_ Engine_Load : 7|8@0+ (0.392,0) [0|100] "%" Service__01

BO_ 5 Engine_Coolant_Temperature: 1 Service__01
   SG_ Engine_Coolant_Temp : 0|8@1- (1,-40) [-40|215] "deg_C" Service__01

BO_ 6 Short_Term_Fuel_Trim_Bank1: 1 Service__01
   SG_ InstantFuelTrimBank1 : 0|8@1- (0.781,-100) [-100|99.2] "%" Service__01

BO_ 7 Long_Term_Fuel_Trim_Bank1: 1 Service__01
   SG_ LongTermFuelTrimBank1 : 0|8@1- (0.781,-100) [-100|99.2] "%" Service__01

BO_ 8 Short_Term_Fuel_Trim_Bank2: 1 Service__01
   SG_ InstantFuelTrimBank2 : 0|8@1- (0.781,-100) [-100|99.2] "%" Service__01

BO_ 9 Long_Term_Fuel_Trim_Bank2: 1 Service__01
   SG_ LongTermFuelTrimBank2 : 0|8@1- (0.781,-100) [-100|99.2] "%" Service__01

BO_ 10 Fuel_Pressure: 1 Service__01
   SG_ Fuel_Pressure : 0|8@1+ (3,0) [0|765] "kPa" Service__01

BO_ 11 Intake_Manifold_Absolute_Pressure: 1 Service__01
   SG_ IMAP : 0|8@1+ (1,0) [0|255] "kPa" Service__01

BO_ 12 Engine_RPM: 2 Service__01
   SG_ A : 7|8@0+ (1,0) [0|6000] "RPM" Service__01
   SG_ B : 15|8@0+ (1,0) [0|6000] "RPM" Service__01

BO_ 13 Vehicle_Speed: 1 Service__01
   SG_ Vehicle_Speed : 0|8@1+ (1,0) [0|255] "kph" Vector__XXX

BO_ 14 Spark_Timing_Advance: 1 Service__01
   SG_ Spark_Timing_Advance : 0|8@1- (0.5,-64) [-64|63.5] "deg_before_TDC" Service__01

BO_ 15 Intake_Air_Temperature: 1 Service__01
   SG_ Intake_Air_Temp : 0|8@1- (1,-40) [-40|215] "deg_C" Service__01

BO_ 16 MAF_air_flow_rate: 2 Service__01
   SG_ MAF_A : 0|8@1+ (1,0) [0|0] "" Vector__XXX
   SG_ MAF_B : 7|32@0- (1,0) [0|655.35] "g/s" Vector__XXX

BO_ 17 Throttle_Position: 1 Service__01
   SG_ Throttle_Position : 0|8@1- (0.392,0) [0|100] "%" Service__01

BO_ 67 Absolute_Load_Value: 2 Service__01
   SG_ A : 0|8@1+ (100.352,0) [0|25700] "%" Service__01
   SG_ B : 8|8@1+ (0.392,0) [0|25700] "%" Vector__XXX

BO_ 69 Relative_Throttle_Position: 1 Service__01
   SG_ Rel_Throttle_Position : 0|8@1+ (0.392,0) [0|100] "%" Service__01

BO_ 31 Run_Since_Engine_Start: 2 Service__01
   SG_ A : 0|8@1+ (256,0) [0|65535] "seconds" Service__01
   SG_ B : 8|8@1+ (1,0) [0|65535] "seconds" Service__01

BA_DEF_ BO_ "GenMsgBackgroundColor" STRING ;
BA_DEF_ BO_ "GenMsgForegroundColor" STRING ;
BA_DEF_DEF_ "GenMsgBackgroundColor" "#ffffff";
BA_DEF_DEF_ "GenMsgForegroundColor" "#000000";
CM_ BO_ 1 "(Includes malfunction indicator lamp (MIL) status and number of DTCs.)";
CM_ SG_ 1 MIL_ON_OFF "Iindicates_if_the_MIL_is_on_(or_should_be_on)";
CM_ SG_ 1 DTC_COUNT "Number_of_confirmed_emissions-related_DTCs_available_for_display.";
CM_ SG_ 1 RESERVED "Reserved_(should_be_0)";
CM_ SG_ 10 Fuel_Pressure "Fuel_pressure_from_fuel_tank";
CM_ SG_ 12 A "To_calculate_RPM_(256A+B)/4";
CM_ SG_ 12 B "To_calculate_RPM_(256A+B)/4";
CM_ SG_ 14 Spark_Timing_Advance "Spark_Timing_Advance";
CM_ BO_ 15 "Intake air temperature in degrees Celsius";
CM_ SG_ 15 Intake_Air_Temp "Intake_Air_Temperature";
CM_ BO_ 16 "The amount of air flowing through the engine in grams per second";
CM_ SG_ 16 MAF_B "units_in_grams/sec";
CM_ BO_ 67 "Absolute engine load";
CM_ SG_ 67 A "A+B";
CM_ SG_ 67 B "A+B";
CM_ BO_ 31 "Run time since engine start";
VAL_ 1 NO_NAME 0 "Spark_ignition_monitors_supported" 1 "Compression_ignition_monitors_supported_(e.g._Diesel_engines)";
VAL_ 3 Fuel_System_1 1 "Open_loop_due_to_insufficient_engine_temperature" 2 "Closed_loop,_using_oxygen_sensor_feedback_to_determine_fuel_mix" 4 "Open_loop_due_to_engine_load_OR_fuel_cut_due_to_deceleration" 8 "Open_loop_due_to_system_failure" 16 "Closed_loop,_using_at_least_one_oxygen_sensor_but_there_is_a_fault_in_the_feedback_system";
VAL_ 3 Fuel_System_2 1 "Open_loop_due_to_insufficient_engine_temperature" 2 "Closed_loop,_using_oxygen_sensor_feedback_to_determine_fuel_mix" 4 "Open_loop_due_to_engine_load_OR_fuel_cut_due_to_deceleration" 8 "Open_loop_due_to_system_failure" 16 "Closed_loop,_using_at_least_one_oxygen_sensor_but_there_is_a_fault_in_the_feedback_system";
